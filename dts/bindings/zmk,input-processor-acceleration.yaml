## dts/bindings/zmk,input-processor-acceleration.yaml
```yaml
# SPDX-License-Identifier: MIT
description: ZMK Velocity-Based Pointer Acceleration Input Processor

compatible: "zmk,input-processor-acceleration"

include: ip_zero_param.yaml

properties:
  input-type:
    type: int
    required: true
    description: Input event type to accelerate (e.g. INPUT_EV_REL for relative events)

  codes:
    type: array
    description: |
      Input event codes to process (e.g. INPUT_REL_X, INPUT_REL_Y).
      If not specified, defaults to INPUT_REL_X and INPUT_REL_Y.

  sensitivity:
    type: int
    default: 1000
    description: |
      Base sensitivity multiplier (scaled by 1000).
      1000 = 1.0x, 1200 = 1.2x, 800 = 0.8x.

  min-factor:
    type: int
    default: 1000    # 1.000x (no deceleration by default)
    description: |
      Minimum pointer speed factor (scaled by 1000).
      Values <1000 slow down movements at very low speeds.
      Used primarily in Level 2 (Standard) mode.

  max-factor:
    type: int
    default: 3500    # 3.500x
    description: |
      Maximum acceleration factor (scaled by 1000).
      Movement will be accelerated up to this factor at high speeds.

  speed-threshold:
    type: int
    default: 1000    # counts per second
    description: |
      Pointer speed (counts/sec) at which acceleration factor reaches 1.0.
      Used in Level 2 (Standard) mode.

  speed-max:
    type: int
    default: 6000    # counts per second
    description: |
      Pointer speed (counts/sec) at which maximum acceleration is reached.
      Used in Level 2 (Standard) mode.

  acceleration-exponent:
    type: int
    default: 1       # 1 = linear
    description: |
      Exponent for the acceleration curve in Level 2 (Standard) mode.
      1 = linear, 2 = quadratic, 3 = cubic.

  curve-type:
    type: int
    default: 1
    description: |
      Acceleration curve type for Level 1 (Simple) mode.
      0 = Linear (gradual), 1 = Mild (smooth), 2 = Strong (aggressive).

  sensor-dpi:
    type: int
    default: 800
    description: |
      Sensor DPI/CPI setting. Used for automatic sensitivity scaling.
      Standard reference is 800 DPI.

  y-boost:
    type: int
    default: 1000
    description: |
      Y-axis sensitivity boost (scaled by 1000).
      1000 = same as X, 1200 = 1.2x Y-axis boost.
      Useful for widescreen displays.

  track-remainders:
    type: boolean
    description: Accumulate and apply fractional movement remainders for higher precision.
```

## src/Kconfig
```kconfig
# SPDX-License-Identifier: MIT
# Kconfig for ZMK Input Processor Acceleration

DT_COMPAT_ZMK_INPUT_PROCESSOR_ACCELERATION := zmk,input-processor-acceleration

config ZMK_INPUT_PROCESSOR_ACCELERATION
    bool "Enable input processor acceleration"
    default $(dt_compat_enabled,$(DT_COMPAT_ZMK_INPUT_PROCESSOR_ACCELERATION))
    depends on ZMK_POINTING
    depends on INPUT
    default y
    help
        Enables velocity-based acceleration for relative pointer input events.

config INPUT_PROCESSOR_ACCELERATION_INIT_PRIORITY
    int "Input processor acceleration initialization priority"
    depends on ZMK_INPUT_PROCESSOR_ACCELERATION
    default INPUT_INIT_PRIORITY

# =============================================================================
# CONFIGURATION LEVEL SELECTION
# =============================================================================

choice INPUT_PROCESSOR_ACCEL_LEVEL
    prompt "Acceleration Configuration Level"
    depends on ZMK_INPUT_PROCESSOR_ACCELERATION
    default INPUT_PROCESSOR_ACCEL_LEVEL_SIMPLE
    help
      Choose the complexity level for pointing device acceleration:
      - Simple: Input magnitude-based curves with presets
      - Standard: Speed-based acceleration with advanced curves

config INPUT_PROCESSOR_ACCEL_LEVEL_SIMPLE
    bool "Simple (magnitude-based curves with presets)"
    help
      Simple configuration using input magnitude for acceleration curves.
      Includes sensitivity, max-factor, curve-type, Y-boost, and DPI adjustment.

config INPUT_PROCESSOR_ACCEL_LEVEL_STANDARD
    bool "Standard (speed-based acceleration with presets)"
    help
      Standard configuration using speed-based acceleration with exponential curves,
      configurable speed thresholds, and min/max factors.

endchoice

config INPUT_PROCESSOR_ACCEL_LEVEL
    int
    default 1 if INPUT_PROCESSOR_ACCEL_LEVEL_SIMPLE
    default 2 if INPUT_PROCESSOR_ACCEL_LEVEL_STANDARD

# =============================================================================
# PRESET SELECTION (shared between levels)
# =============================================================================

choice INPUT_PROCESSOR_ACCEL_PRESET
    prompt "Acceleration Preset"
    depends on ZMK_INPUT_PROCESSOR_ACCELERATION
    default INPUT_PROCESSOR_ACCEL_PRESET_CUSTOM
    help
      Choose a preset configuration based on usage and device type.

config INPUT_PROCESSOR_ACCEL_PRESET_CUSTOM
    bool "Custom (configure via device tree)"

# Office presets
config INPUT_PROCESSOR_ACCEL_PRESET_OFFICE_OPTICAL
    bool "Office - Optical Mouse (800 DPI)"
    help
      Conservative acceleration for office work with standard optical mouse.
      Sensitivity: 1.0x, Max: 2.2x, Curve: Mild, DPI: 800

config INPUT_PROCESSOR_ACCEL_PRESET_OFFICE_LASER
    bool "Office - Laser Mouse (1600 DPI)"
    help
      Conservative acceleration for office work with laser mouse.
      Sensitivity: 1.0x, Max: 1.5x, Curve: Linear, DPI: 1600

config INPUT_PROCESSOR_ACCEL_PRESET_OFFICE_TRACKBALL
    bool "Office - Trackball (400 DPI)"
    help
      Conservative acceleration for office work with trackball.
      Sensitivity: 1.5x, Max: 2.0x, Curve: Mild, DPI: 400

config INPUT_PROCESSOR_ACCEL_PRESET_OFFICE_TRACKPAD
    bool "Office - Trackpad/Touchpad (1000 DPI)"
    help
      Conservative acceleration for office work with trackpad.
      Sensitivity: 1.2x, Max: 1.8x, Curve: Linear, DPI: 1000

# Gaming presets
config INPUT_PROCESSOR_ACCEL_PRESET_GAMING_OPTICAL
    bool "Gaming - Optical Mouse (1200 DPI)"
    help
      Balanced acceleration for gaming with optical mouse.
      Sensitivity: 1.0x, Max: 2.5x, Curve: Strong, DPI: 1200

config INPUT_PROCESSOR_ACCEL_PRESET_GAMING_LASER
    bool "Gaming - Laser Mouse (3200 DPI)"
    help
      Balanced acceleration for gaming with high-DPI laser mouse.
      Sensitivity: 0.6x, Max: 2.5x, Curve: Strong, DPI: 3200

config INPUT_PROCESSOR_ACCEL_PRESET_GAMING_TRACKBALL
    bool "Gaming - Trackball (800 DPI)"
    help
      Balanced acceleration for gaming with trackball.
      Sensitivity: 1.2x, Max: 2.3x, Curve: Strong, DPI: 800

config INPUT_PROCESSOR_ACCEL_PRESET_GAMING_TRACKPAD
    bool "Gaming - Trackpad/Touchpad (1200 DPI)"
    help
      Balanced acceleration for gaming with trackpad.
      Sensitivity: 1.1x, Max: 2.2x, Curve: Mild, DPI: 1200

# High sensitivity presets
config INPUT_PROCESSOR_ACCEL_PRESET_HIGH_SENS_OPTICAL
    bool "High Sensitivity - Optical Mouse (1600 DPI)"
    help
      High sensitivity for fast movements with optical mouse.
      Sensitivity: 1.1x, Max: 2.8x, Curve: Mild, DPI: 1600

config INPUT_PROCESSOR_ACCEL_PRESET_HIGH_SENS_LASER
    bool "High Sensitivity - Laser Mouse (6400 DPI)"
    help
      High sensitivity for fast movements with high-DPI laser mouse.
      Sensitivity: 0.5x, Max: 2.8x, Curve: Mild, DPI: 6400

config INPUT_PROCESSOR_ACCEL_PRESET_HIGH_SENS_TRACKBALL
    bool "High Sensitivity - Trackball (800 DPI)"
    help
      High sensitivity for fast movements with trackball.
      Sensitivity: 1.4x, Max: 2.6x, Curve: Mild, DPI: 800

config INPUT_PROCESSOR_ACCEL_PRESET_HIGH_SENS_TRACKPAD
    bool "High Sensitivity - Trackpad/Touchpad (1200 DPI)"
    help
      High sensitivity for fast movements with trackpad.
      Sensitivity: 1.3x, Max: 2.4x, Curve: Mild, DPI: 1200

endchoice
```
